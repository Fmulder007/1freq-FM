/*
  1freq-FM5
  Генератор на Si5351 с переключением двух частот по пину управления.
  Частоты хранятся в EEPROM МК в читаемом текстовом виде.

  Назначение пинов:
    controlpin (PC0/ADC0, pin 23) — вход управления
      замкнут на GND → FreqHigh
      висит свободен → FreqLow (внутренняя подтяжка INPUT_PULLUP)

  EEPROM: 2 строки по 16 байт
    0x00: "UP=65000000\0"  — частота при замкнутом пине
    0x10: "DN=60000000\0"  — частота при свободном пине

  Формирование и запись EEPROM:
    - Для подготовки данных используется скрипт make_eeprom.cmd.
      Он запрашивает частоты и генерирует файл eeprom.hex в формате Intel HEX.
    - Прошивка EEPROM выполняется через AVRDUDE_PROG 3.3:
        Memory: EEPROM
        Format: Intel HEX
        File: eeprom.hex
      Затем нажать «Запись».

  Чтение EEPROM в коде:
    При старте скетч проверяет наличие корректных меток:
      "UP=" по адресу 0
      "DN=" по адресу 16

    Проверяются ВСЕ ТРИ символа каждой метки.
    Если EEPROM пуст или повреждён — записываются значения DEFAULT_UP и DEFAULT_DN.

  Важно:
    - Длина каждой строки — не более 16 байт (включая завершающий '\0').
    - Не менять метки "UP=" и "DN=" — иначе скетч не сможет прочитать частоту.
    - Частота хранится в EEPROM в обычном текстовом виде.
    - uint32_t позволяет хранить частоты, например 130000000 Гц.

  FUSE
    Low:     62
    High:    D1
    Extended: FD
*/


// === Настройки ===

#define Si_Xtall_Freq 27007840UL  // Частота кварца Si5351, Гц

#define controlpin    14          // M328 pin #23 (PC0/ADC0)

#define Si_cload      SI5351_CRYSTAL_LOAD_10PF

#define DEFAULT_UP    2000000UL  // КЗ пина на землю (значение по умолчанию)
#define DEFAULT_DN    1000000UL  // Пин свободен (значение по умолчанию)


#include "si5351a.h"
#include <EEPROM.h>


Si5351 Si;


// Состояние управляющего входа
uint8_t lastState = 2;


// Время последнего изменения состояния
uint32_t lastChange = 0;


// Частоты
uint32_t FreqHigh;
uint32_t FreqLow;


// ============================================================
// SETUP
// ============================================================

void setup() {

  // PC0 как вход с внутренней подтяжкой к VCC.
  //
  // LOW  = вход замкнут на GND → FreqHigh
  // HIGH = вход свободен       → FreqLow

  pinMode(controlpin, INPUT_PULLUP);


  // Читаем частоты из EEPROM
  loadFreqFromEEPROM();


  // Инициализация Si5351

  Si.setup(0, 0, 0);

  Si.cload(Si_cload);

  Si.set_xtal_freq(Si_Xtall_Freq);


  // Запоминаем начальное состояние управляющего входа

  lastState = digitalRead(controlpin);


  // Устанавливаем начальную частоту

  setFreqByPin(lastState);
}


// ============================================================
// LOOP
// ============================================================

void loop() {

  uint8_t state = digitalRead(controlpin);


  // Если состояние изменилось и прошло более 50 мс,
  // считаем изменение действительным.
  //
  // Это простая защита от дребезга контактов.

  if (state != lastState && millis() - lastChange > 50) {

    lastState  = state;
    lastChange = millis();

    setFreqByPin(state);
  }
}


// ============================================================
// Установка частоты по состоянию управляющего пина
// ============================================================

void setFreqByPin(uint8_t state) {

  if (state == LOW) {

    // Пин замкнут на землю
    Si.set_freq(FreqHigh);

  } else {

    // Пин свободен, работает INPUT_PULLUP
    Si.set_freq(FreqLow);
  }

  // Применяем новую частоту к CLK0

  Si.update_freq(0);
}


// ============================================================
// Проверка метки EEPROM
//
// Для addr = 0 проверяем:
//
//   UP=
//
// Для addr = 16 проверяем:
//
//   DN=
//
// Проверяются ВСЕ ТРИ символа.
// ============================================================

bool checkLabel(uint8_t addr, char c1, char c2) {

  return EEPROM.read(addr)     == c1 &&
         EEPROM.read(addr + 1) == c2 &&
         EEPROM.read(addr + 2) == '=';
}


// ============================================================
// Чтение частот из EEPROM при старте
// ============================================================

void loadFreqFromEEPROM() {

  // Проверяем полностью обе метки:
  //
  // 0x00: UP=
  // 0x10: DN=
  //
  // Если хотя бы один символ неправильный,
  // считаем EEPROM пустой или повреждённой.

  if (!checkLabel(0, 'U', 'P') ||
      !checkLabel(16, 'D', 'N')) {

    // Записываем частоты по умолчанию

    saveFreqToEEPROM(DEFAULT_UP, DEFAULT_DN);
  }


  // Читаем частоты

  FreqHigh = readFreq(0);
  FreqLow  = readFreq(16);


  // Если число не удалось прочитать,
  // восстанавливаем EEPROM.

  if (FreqHigh == 0 || FreqLow == 0) {

    saveFreqToEEPROM(DEFAULT_UP, DEFAULT_DN);

    FreqHigh = DEFAULT_UP;
    FreqLow  = DEFAULT_DN;
  }
}


// ============================================================
// Запись обеих частот в EEPROM
//
// Формат остаётся строго:
//
// 0x00: UP=65000000\0
// 0x10: DN=60000000\0
//
// Каждая область занимает ровно 16 байт.
// ============================================================

void saveFreqToEEPROM(uint32_t up, uint32_t dn) {

  writeFreq(0,  'U', up);
  writeFreq(16, 'D', dn);
}


// ============================================================
// Запись одной частоты
//
// addr = 0  → UP=...
// addr = 16 → DN=...
//
// Формат:
//
// UP=65000000\0
//
// или:
//
// DN=130000000\0
//
// Никаких sprintf(), strlen() и т.п.
// ============================================================

void writeFreq(uint8_t addr, char prefix, uint32_t freq) {

  // Записываем текстовую метку

  EEPROM.update(addr, prefix);


  if (prefix == 'U') {

    EEPROM.update(addr + 1, 'P');

  } else {

    EEPROM.update(addr + 1, 'N');
  }


  EEPROM.update(addr + 2, '=');


  // Временный буфер для цифр.
  //
  // uint32_t может содержать максимум 10 десятичных цифр.

  char digits[10];

  uint8_t n = 0;


  // Получаем цифры справа налево.
  //
  // Например:
  //
  // 130000000
  //
  // сначала получим:
  //
  // 0 0 0 0 0 0 0 3 1

  do {

    digits[n++] = '0' + (freq % 10);

    freq /= 10;

  } while (freq);


  // Записываем цифры в EEPROM уже слева направо.

  uint8_t pos = addr + 3;


  while (n) {

    EEPROM.update(pos++, digits[--n]);
  }


  // Завершающий нулевой байт строки

  EEPROM.update(pos++, 0);


  // Очищаем оставшиеся байты 16-байтной области EEPROM.
  //
  // Это сохраняет прежний формат:
  // вся строка занимает ровно 16 байт.

  while (pos < addr + 16) {

    EEPROM.update(pos++, 0);
  }
}


// ============================================================
// Чтение частоты из EEPROM
//
// addr = 0  → UP=...
// addr = 16 → DN=...
//
// Читаем только цифры после знака '='.
//
// Например:
//
// UP=130000000
//    ^^^^^^^^^
//
// превращается в:
//
// 130000000UL
// ============================================================

uint32_t readFreq(uint8_t addr) {

  uint32_t freq = 0;


  // Первые три байта занимают:
  //
  // UP=
  // или
  // DN=
  //
  // Поэтому начинаем с addr + 3.

  for (uint8_t i = 3; i < 15; i++) {

    uint8_t c = EEPROM.read(addr + i);


    // Завершение строки

    if (c == 0)
      break;


    // После '=' разрешены только цифры.
    //
    // Если встретился другой символ,
    // считаем строку повреждённой.

    if (c < '0' || c > '9')
      return 0;


    // Добавляем очередную цифру

    freq = freq * 10UL + (c - '0');
  }


  return freq;
}
